MEMORY
{
  /*
   * Part 1: memory Layout
   */

  /* Near SRAM banks, can be used for Instruction or Data */
  SRAM_N_BANK00   : ORIGIN = 0x00000000, LENGTH = 0x00008000
  SRAM_N_BANK01   : ORIGIN = 0x00008000, LENGTH = 0x00008000
  SRAM_N_BANK02   : ORIGIN = 0x00010000, LENGTH = 0x00008000
  SRAM_N_BANK03   : ORIGIN = 0x00018000, LENGTH = 0x00008000
  SRAM_N_BANK04   : ORIGIN = 0x00020000, LENGTH = 0x00008000
  SRAM_N_BANK05   : ORIGIN = 0x00028000, LENGTH = 0x00008000
  SRAM_N_BANK06   : ORIGIN = 0x00030000, LENGTH = 0x00008000
  SRAM_N_BANK07   : ORIGIN = 0x00038000, LENGTH = 0x00008000
  SRAM_N_BANK08   : ORIGIN = 0x00040000, LENGTH = 0x00008000
  SRAM_N_BANK09   : ORIGIN = 0x00048000, LENGTH = 0x00008000
  SRAM_N_BANK10   : ORIGIN = 0x00050000, LENGTH = 0x00008000
  SRAM_N_BANK11   : ORIGIN = 0x00058000, LENGTH = 0x00008000
  SRAM_N_BANK12   : ORIGIN = 0x00060000, LENGTH = 0x00008000
  SRAM_N_BANK13   : ORIGIN = 0x00068000, LENGTH = 0x00008000
  SRAM_N_BANK14   : ORIGIN = 0x00070000, LENGTH = 0x00008000
  SRAM_N_BANK15   : ORIGIN = 0x00078000, LENGTH = 0x00008000

  /* Far SRAM banks, for Instruction only */
  SRAM_F_BANK00   : ORIGIN = 0x00080000, LENGTH = 0x00010000
  SRAM_F_BANK01   : ORIGIN = 0x00090000, LENGTH = 0x00010000
  SRAM_F_BANK02   : ORIGIN = 0x000A0000, LENGTH = 0x00010000
  SRAM_F_BANK03   : ORIGIN = 0x000B0000, LENGTH = 0x00010000
  SRAM_F_BANK04   : ORIGIN = 0x000C0000, LENGTH = 0x00010000
  SRAM_F_BANK05   : ORIGIN = 0x000D0000, LENGTH = 0x00010000
  SRAM_F_BANK06   : ORIGIN = 0x000E0000, LENGTH = 0x00010000
  SRAM_F_BANK07   : ORIGIN = 0x000F0000, LENGTH = 0x00010000

  /* RAM for IPC */
  SRAM_CPU_2_CLA  : ORIGIN = 0x00202000, LENGTH = 0x00001000
  SRAM_CLA_2_CPU  : ORIGIN = 0x00203000, LENGTH = 0x00001000

  /* RAM for bootloader */
  BOOT_RAM   : ORIGIN = 0x00280000, LENGTH = 0x00002000

  /* Flash Memory: store instruction and data, and copy to RAM by bootloader */
  FLASH_DATA : ORIGIN = 0x30000000, LENGTH = 0x00100000


  /*
   * Part 2: memory allocation
   */

  /* 1. SRAM is allocated by BANK (32KB blocks, 0x8000)
   * 2. SRAM_N_BANKxx are free to allocate to core/cla, for instruction or data
   * 3. SRAM_F_BANKxx are for core instruction only
   * 4. Reserve last 4KB of SRAM of core for interrupt vector
   * 5. DONOT allocation address 0x0 (SRAM_BANK 00) to data
   */

  /* CLA IRAM: 32KB. SRAM_N_BANK 00 */
  GS_RAM_CORE0_CLA_INST : ORIGIN = 0x00000000, LENGTH = 0x00008000
  
  /* CLA DRAM: 32KB. SRAM_N_BANK 01 */
  GS_RAM_CORE0_CLA_DATA : ORIGIN = 0x00008000, LENGTH = 0x00008000
  
  /* CORE DRAM: 128 KB (0x20000) */
  GS_RAM_CORE0_DATA : ORIGIN = 0x00010000, LENGTH = 0x0001FC00
  GS_RAM_CORE0_IVEC : ORIGIN = 0x0002FC00, LENGTH = 0x00000400
  
  /* CORE IRAM: 320KB (0x50000) */
  GS_RAM_CORE0_INST : ORIGIN = 0x00030000, LENGTH = 0x00050000

  /* Fake memory regions for specifying stack size */
  STACK             : ORIGIN = 0x00000000, LENGTH = 0x00000400
}
